/*
*********************************************************************************************************
*
*	模块名称 : PM25驱动模块
*	文件名称 : bsp_pm25.c
*	版    本 : V1.0
*	说    明 : 
*
*	修改记录 :
*		版本号  日期        作者     说明
*		V1.0    2024-06-04 	lawrence  正式发布
*
*	Copyright (C), 2014-2024, 德致伦电子
*
*********************************************************************************************************
*/

///////////////////////////////////////
/* 头文件包含区 */
#include "bsp.h"
///////////////////////////////////////
/* 变量定义区 */
static const uint8_t PM25_READ_CMD[9] = {0xFF,0x01,0x86,0x00,0x00,0x00,0x00,0x00,0x79};//读取CO2命令
uint8_t PM25_TEMP_BUF[PM25_TEMP_BUF_LEN] = {0x00};//CO2缓存
///////////////////////////////////////
/* 外部变量申明区 */

///////////////////////////////////////
/* 函数申明区 */

///////////////////////////////////////
/* 函数实体区 */
/*
*********************************************************************************************************
*	函 数 名: PM25_TEMP_BUF_Clear
*	功能说明: PM25缓存清除
*	形    参：无
*	返 回 值: 无
*********************************************************************************************************
*/
void PM25_TEMP_BUF_Clear(void)
{
	uint8_t i=0;
	for(i=0;i<PM25_TEMP_BUF_LEN;i++)
	{
		PM25_TEMP_BUF[i] = 0;
	}
}
/*
*********************************************************************************************************
*	函 数 名: getCheckSum
*	功能说明: 计算校验和
*	形    参：uint8_t *packet 数据指针
*	返 回 值: 返回校验值
*********************************************************************************************************
*/
static uint8_t getCheckSum(uint8_t *packet)
{
	uint8_t i,checksum = 0;
	for(i=1;i<8;i++)
	{
		checksum += packet[i];
	}
	checksum = 0xff - checksum;
	checksum+=1;
	return checksum;
}
/*
*********************************************************************************************************
*	函 数 名: PM25_READ
*	功能说明: PM25读取数据
*	形    参：无
*	返 回 值: 返回PM25值
*********************************************************************************************************
*/
uint16_t PM25_READ(void)
{
	uint16_t pm25_value = 0;
	uint8_t len3 = 0;
	
	UART3_Send_Data((uint8_t*)PM25_READ_CMD,9);//读取PM25数值
	delay_ms(20);
	
	UART3_Receive_Data(PM25_TEMP_BUF,&len3);
	
	if((len3 == 9) && (getCheckSum(PM25_TEMP_BUF) == PM25_TEMP_BUF[8]))
	{
		pm25_value = PM25_TEMP_BUF[2];
		pm25_value = (pm25_value << 8) + PM25_TEMP_BUF[3];
		len3 = 0;
		PM25_TEMP_BUF_Clear();//清空buf
		return pm25_value;//返回正确数值
	}
	else
	{
		pm25_value = 65535;//返回错误数值
		PM25_TEMP_BUF_Clear();//清空buf
		return pm25_value;//返回错误数值
	}
}
///////////////////////////////////////

/***************************** 德致伦电子 DeZLinc (END OF FILE) *********************************/
