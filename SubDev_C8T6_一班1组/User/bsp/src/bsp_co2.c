/*
*********************************************************************************************************
*
*	模块名称 : CO2驱动模块
*	文件名称 : bsp_co2.c
*	版    本 : V1.0
*	说    明 : 
*
*	修改记录 :
*		版本号  日期        作者     说明
*		V1.0    2024-06-03 付燕华  正式发布
*
*	Copyright (C), 2014-2024, 德致伦电子
*
*********************************************************************************************************
*/

///////////////////////////////////////
/* 头文件包含区 */
#include "bsp.h"
///////////////////////////////////////
/* 变量定义区 */
static const uint8_t CO2_READ_CMD[9]={0xFF,0x01,0x86,0x00,0x00,0x00,0x00,0x00,0x79};//读取CO2命令 
uint8_t CO2_TEMP_BUF [CO2_TEMP_BUF_LEN]={0x00};//CO2缓存  ///////////////////////////////////////
/* 外部变量申明区 */

///////////////////////////////////////
/* 函数申明区 */

///////////////////////////////////////
/* 函数实体区 */

/*
*********************************************************************************************************
*	函 数 名:CO2_TEMP_BUF_Clear 
*	功能说明: CO2缓存清除。 
*	形    参：无
*	返 回 值: 无
*********************************************************************************************************
*/
void CO2_TEMP_BUF_Clear(void) 
{ 
	uint8_t i=0; 
	for(i=0;i<CO2_TEMP_BUF_LEN;i++) 
	{ 
		CO2_TEMP_BUF[i]=0; 
	}	 
} 
/*
*********************************************************************************************************
*	函 数 名: getCheckSum
*	功能说明: 计算和校验。 
*	形    参：uint8_t *packet 数据指针
*	返 回 值: 返回和校验值
*********************************************************************************************************
*/

uint8_t getCheckSumCo(uint8_t *packet) 
{ 
	uint8_t i,checksum=0; 
	for(i=1;i<8;i++) 
	{ 
		checksum += packet[i]; 
	} 
	checksum = 0xff - checksum; 
	checksum += 1; 
	return checksum; 
}
/*
*********************************************************************************************************
*	函 数 名: CO2_READ
*	功能说明: CO2读取数据。
*	形    参：无
*	返 回 值: 返回CO2值
*********************************************************************************************************
*/
uint16_t CO2_READ(void) 
{ 
	uint16_t co2_value = 0; 
	uint8_t len3 = 0; 
  
	USART2_Send_Data( (uint8_t*)CO2_READ_CMD,9);//读取CO2数值 
	delay_ms(20); 
	USART2_Receive_Data(CO2_TEMP_BUF,&len3); 
  
	if( ( len3 == 9 ) && ( getCheckSumCo( CO2_TEMP_BUF ) == CO2_TEMP_BUF[8] ) ) 
	{ 
		co2_value = CO2_TEMP_BUF[2]; 
		co2_value = ( co2_value << 8 ) + CO2_TEMP_BUF[3]; 
		//printf("CO2 value is %d \r\n",co2_value); 
		len3 = 0; 
		CO2_TEMP_BUF_Clear();//清空buf 
		return co2_value;//返回正确数值 
	} 
	else 
	{ 
		//printf("len3 = %d\r\n",len3); 
		co2_value = 65535;//返回错误数值 
		CO2_TEMP_BUF_Clear();//清空buf 
		return co2_value;//返返回错误数值 
	} 
} 
///////////////////////////////////////

/***************************** 德致伦电子 DeZLinc (END OF FILE) *********************************/
